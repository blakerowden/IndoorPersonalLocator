## CMakeLists.txt
```
# SPDX-License-Identifier: Apache-2.0

set(BOARD thingy52_nrf52832)
set(BOARD_FLASH_RUNNER jlink)
set(CONF_FILE prj.conf bt.conf)

cmake_minimum_required(VERSION 3.20.0)
find_package(Zephyr REQUIRED HINTS $ENV{ZEPHYR_BASE})
project(ahu)

#Add Include Directories
include_directories(
                        ../../oslib/mobile_drivers/ble_mobile
                        ../../oslib/mobile_drivers/imu_mobile
                        ../../oslib/static_drivers/ultrasonic_static
                        ../../oslib/static_drivers/ble_static
                        ../../oslib/base_drivers
                        ../../oslib/common
                        )

#Add Target Sources
target_sources(app PRIVATE
                        ../../oslib/mobile_drivers/ble_mobile/ble_mobile_scan.c
                        ../../oslib/mobile_drivers/ble_mobile/mobile_ble.c
                        ../../oslib/mobile_drivers/imu_mobile/hal_imu.c
                        ../../oslib/mobile_drivers/imu_mobile/inv_mpu_dmp_motion_driver.c
                        ../../oslib/mobile_drivers/imu_mobile/inv_mpu.c
                        ../../oslib/mobile_drivers/imu_mobile/zephyr_i2c.c
                        ../../oslib/static_drivers/ultrasonic_static/ultrasonic_static.c
                        ../../oslib/static_drivers/ble_static/static_ble.c
                        ../../oslib/base_drivers/shell_base.c
                        ../../oslib/common/hci_driver.c
                        src/main.c
                        )

zephyr_library_include_directories(${ZEPHYR_BASE}/samples/bluetooth)
```

## prj.conf
```kconfig
CONFIG_GPIO=y
CONFIG_CBPRINTF_FP_SUPPORT=y
CONFIG_USE_SEGGER_RTT=y
CONFIG_RTT_CONSOLE=y
CONFIG_STDOUT_CONSOLE=y
CONFIG_I2C=y
CONFIG_SENSOR=y
CONFIG_LIS2DH=y
CONFIG_TIMING_FUNCTIONS=y
```

## bt.conf
```kconfig
#------------------------------------------------------------------------------
                                #BT Config
#------------------------------------------------------------------------------
#BT On
CONFIG_BT=y
#Become an observer 
CONFIG_BT_OBSERVER=y
#BT Log Level Debug
CONFIG_BT_DEBUG_LOG=y

CONFIG_BT_DEVICE_NAME="Weather Station - Application Host Unit"
#Enable support for the Security Manager Protocol (SMP), making it possible to pair devices over LE.
CONFIG_BT_SMP=y
#Enable data signing which is used for transferring authenticated data in an unencrypted connection.
CONFIG_BT_SIGNING=y
#Select this for LE Central role support
CONFIG_BT_CENTRAL=y
#Enable GATT Device Information service
CONFIG_BT_DIS=y
#Enabled Client procedures 
CONFIG_BT_GATT_CLIENT=y
#Enable local Privacy Feature support. This makes it possible to use Resolvable Private Addresses (RPAs).
CONFIG_BT_PRIVACY=y
#Bluetooth device appearance. 
CONFIG_BT_DEVICE_APPEARANCE=833
# Set the BLE to transmit with +4dbm power
CONFIG_BT_CTLR_TX_PWR_PLUS_8=y

CONFIG_BT_CONN_TX_MAX=16
#CONFIG_BT_CTLR_TX_BUFFERS=16

CONFIG_BT_PERIPHERAL=y
```

## src/main.c
```c
/**
 * @file main.c
 * @author Blake Rowden (b.rowden@uqconnect.edu.au) - s4427634
 * @brief Mobile/Static Node
 * @version 0.2
 * @date 2022-03-15
 *
 * @copyright Copyright (c) 2022
 *
 */

#include "main.h"

//#define MODE MODE_MOBILE  // MODE_MOBILE or MODE_STATIC
#define MODE MODE_STATIC

LOG_MODULE_REGISTER(log_main);  // Logging Module

// Threads =====================================================================
#if MODE == MODE_MOBILE
K_THREAD_DEFINE(ble_mobile, BLE_CONNECT_THREAD_STACK, thread_ble_connect, NULL,
                NULL, NULL, BLE_CONNECT_THREAD_PRIORITY, 0, 0);
K_THREAD_DEFINE(ble_mobile_scan, BLE_SCAN_THREAD_STACK, thread_ble_mobile_scan,
                NULL, NULL, NULL, BLE_SCAN_THREAD_PRIORITY, 0, 500);
K_THREAD_DEFINE(read_imu, IMU_THREAD_STACK, thread_imu_rw,
                NULL, NULL, NULL, IMU_THREAD_PRIORITY, 0, 500);
K_THREAD_DEFINE(rssi_monitor, BLE_SCAN_THREAD_STACK, rssi_monitor_thread,
                NULL, NULL, NULL, BLE_SCAN_THREAD_PRIORITY, 0, 500);
// MPU9250 Thread
//K_THREAD_DEFINE(imu, THREAD_IMU_RW_STACK, thread_read_imu, NULL, NULL, NULL, THREAD_PRIORITY_IMU, 0, 100);

#elif MODE == MODE_STATIC
    // INSERT STATIC MODULE SPECIFIC THREADS HERE
    K_THREAD_DEFINE(ultra_read, 2048, thread_ultra_read, NULL, NULL, NULL, 20, 0, 0);
    K_THREAD_DEFINE(ble_static, 8192, thread_ble_adv, NULL, NULL, NULL, 20, 0, 0);
#endif
```

## src/main.h
```c
/**
 * @file main.h
 * @brief
 * @version 0.1
 * @date 2022-04-13
 *
 * @copyright Copyright (c) 2022
 *
 */

#ifndef __MAIN_H__
#define __MAIN_H__

#include <device.h>
#include <devicetree.h>
#include <errno.h>
#include <logging/log.h>
#include <stddef.h>
#include <sys/printk.h>
#include <zephyr.h>
#include <zephyr/types.h>

#include "ble_mobile_scan.h"
#include "mobile_ble.h"
#include "static_ble.h"
#include "shell_base.h"
#include "ultrasonic_static.h"
//#include "hal_imu.h"

// Define Thread Settings ======================================================
#define BLE_CONNECT_THREAD_STACK    4096
#define BLE_DISCOVER_THREAD_STACK   4096
#define BLE_SCAN_THREAD_STACK       4096
#define IMU_THREAD_STACK            4096

#define BLE_CONNECT_THREAD_PRIORITY     2
#define BLE_DISCOVER_THREAD_PRIORITY    2
#define BLE_SCAN_THREAD_PRIORITY        2
#define IMU_THREAD_PRIORITY             2

#define MODE_MOBILE  0
#define MODE_STATIC  1


#endif //__MAIN_H__
```
