## CMakeLists.txt
```
# SPDX-License-Identifier: Apache-2.0

set(CONF_FILE prj.conf)
set(DTC_OVERLAY_FILE dtc_shell.overlay)

cmake_minimum_required(VERSION 3.20.0)
find_package(Zephyr REQUIRED HINTS $ENV{ZEPHYR_BASE})
project(prac1)


target_sources(app PRIVATE src/main.c
    ../../oslib/ahu_drivers/ahu_rgb/rgb_driver.c
    ../../oslib/ahu_drivers/ahu_ble/bluetooth_driver.c
    ../../oslib/ahu_drivers/ahu_timing/time_driver.c
    ../../oslib/ahu_drivers/ahu_ble/hci.c
    ../../oslib/ahu_drivers/ahu_ble/ble_commands.c
    ../../oslib/ahu_drivers/ahu_shell/shell_driver.c
    ../../oslib/ahu_drivers/ahu_button/button_driver.c)

include_directories(app PUBLIC ../../oslib/ahu_drivers/ahu_ble
                    app PUBLIC ../../oslib/ahu_drivers/ahu_rgb
                    app PUBLIC ../../oslib/ahu_drivers/ahu_timing
                    app PUBLIC ../../oslib/ahu_drivers/ahu_shell
                    app PUBLIC ../../oslib/ahu_drivers/ahu_button)

zephyr_library_include_directories(${ZEPHYR_BASE}/samples/bluetooth)
```

## prj.conf
```kconfig
#----------------------------------PRJ SETUP----------------------------------
CONFIG_PRINTK=y
CONFIG_PWM=y
CONFIG_LOG=y
CONFIG_GPIO=y
CONFIG_BT=y
CONFIG_BT_CENTRAL=y
CONFIG_BT_SMP=y
CONFIG_BT_GATT_CLIENT=y
CONFIG_BT_OBSERVER=y
CONFIG_BT_PERIPHERAL=y
CONFIG_BT_CTLR_ADVANCED_FEATURES=y
CONFIG_BT_CTLR_CONN_RSSI=y

#-----------------------------------------------------------------------------

#----------------------------------USB SETUP----------------------------------
CONFIG_USB_DEVICE_STACK=y
CONFIG_USB_DEVICE_PRODUCT="Zephyr USB Shell Sample"
#-----------------------------------------------------------------------------

#--------------------------------USB_OPTIONS----------------------------------
CONFIG_USB_DEVICE_PRODUCT="NRF - Zephyr"
CONFIG_USB_DEVICE_MANUFACTURER="Nordic"
CONFIG_USB_DEVICE_VID=0xC553
CONFIG_USB_DEVICE_PID=0x4012
#-----------------------------------------------------------------------------

#-----------------------------SHELL_CONF--------------------------------------
CONFIG_SHELL_BACKEND_SERIAL_CHECK_DTR=y
CONFIG_UART_LINE_CTRL=y
CONFIG_SHELL_BACKEND_SERIAL_INIT_PRIORITY=51
CONFIG_SHELL=y
CONFIG_SHELL_BACKENDS=y
CONFIG_SHELL_BACKEND_SERIAL=y

CONFIG_SHELL_PROMPT_UART="s4579873:~$"

CONFIG_SHELL_CMDS=y
CONFIG_SHELL_TAB=y
CONFIG_SHELL_TAB_AUTOCOMPLETION=y
CONFIG_SHELL_VT100_COLORS=y
CONFIG_KERNEL_SHELL=y
#-----------------------------------------------------------------------------

#-----------------------------SHELL_LOGGING-----------------------------------
CONFIG_LOG=y
CONFIG_LOG_PRINTK=y
#-----------------------------------------------------------------------------
```

## src/main.c
```c
/*
 ************************************************************************
 * @file main.c
 * @author Boston O'Neill, 45798737
 * @date 04/04/22
 * @brief Main source code to start required threads for prac1.
 **********************************************************************
 */

#include <zephyr.h>
#include <device.h>
#include <devicetree.h>
#include <usb/usb_device.h>
#include <drivers/uart.h>
#include "rgb_driver.h"
#include "bluetooth_driver.h"
#include "time_driver.h"
#include "shell_driver.h"
#include "button_driver.h"

void shell_entry(void *, void *, void *);

K_THREAD_DEFINE(shell_id, SHELL_STACK_SIZE, shell_entry, NULL, NULL, NULL, 3, 0, 0);

K_THREAD_DEFINE(ble_client_id, BLE_CLIENT_STACK_SIZE, ble_client, NULL, NULL, NULL, 3, 0, 0);

K_THREAD_DEFINE(ble_read, BLE_READ_STACK_SIZE, thread_ble_read, NULL, NULL, NULL, 3, 0, 0);

K_THREAD_DEFINE(ble_commands, BLE_COMMAND_STACK_SIZE, thread_ble_commands, NULL, NULL, NULL, 3, 0, 0);

K_THREAD_DEFINE(samp_commands, SAMP_COMMAND_STACK_SIZE, thread_samp_commands, NULL, NULL, NULL, 3, 0, 0);

K_THREAD_DEFINE(button_ble, BUTTON_BLE_STACK_SIZE, thread_button_ble, NULL, NULL, NULL, 3, 0, 0);

void main(void)
{

	init_button_driver();

	init_rgb_led();

}
```
